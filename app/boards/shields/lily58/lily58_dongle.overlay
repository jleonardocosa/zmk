/*
 * Copyright (c) 2022 The ZMK Contributors
 *
 * SPDX-License-Identifier: MIT
 */

#include "lily58.dtsi"

&default_transform {
     col-offset = <20>;
};

&kscan0 {
    col-gpios
        = <&gpio1 6 (GPIO_ACTIVE_LOW | GPIO_PULL_UP)>
        ;
};