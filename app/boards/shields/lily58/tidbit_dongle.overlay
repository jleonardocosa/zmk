/*
 * Copyright (c) 2020 The ZMK Contributors
 *
 * SPDX-License-Identifier: MIT
 */

#include "tidbit_dongle.dtsi"

    &default_transform {
        col-offset = <12>;
    };

    &encoder_1_top_row {
        status = "okay";
    };
    