## app/boards/arm/e73/Kconfig.board
```kconfig
# E73 E01-2G4M08S1C(X) board configuration

# Copyright (c) 2020 The ZMK Contributors
# SPDX-License-Identifier: MIT

config BOARD_E73
	bool "e73"
	depends on SOC_NRF52840_QIAA
```

## app/boards/arm/e73/Kconfig.defconfig
```kconfig
# Copyright (c) 2020 The ZMK Contributors
# SPDX-License-Identifier: MIT

if BOARD_E73

config BOARD
	default "e73"

if USB_DEVICE_STACK

config USB_NRFX
	default y

endif # USB_DEVICE_STACK

config BT_CTLR
	default BT

config ZMK_BLE
	default y

config ZMK_USB
	default y

endif # BOARD_E73
```

## app/boards/arm/nordic_nrf52840/Kconfig.board
```kconfig
# nordic_nrf52840 board configuration

# Copyright (c) 2020 Pete Johanson
# SPDX-License-Identifier: MIT

config BOARD_NORDIC_NRF52840
	bool "nordic_nrf52840"
	depends on SOC_NRF52840_QIAA
```

## app/boards/shields/keebar/Kconfig.shield
```kconfig
# Copyright (c) 2020  The ZMK Contributors
# SPDX-License-Identifier: MIT

config SHIELD_KEEBAR
	def_bool $(shields_list_contains,keebar)
```

## app/boards/shields/lily58/Kconfig.defconfig
```kconfig
if SHIELD_TIDBIT

config ZMK_KEYBOARD_NAME
	default "tidbit"

config ZMK_SPLIT
	default y

config ZMK_SPLIT_BLE_ROLE_CENTRAL
	default n

endif

if SHIELD_LILY58_LEFT

config ZMK_KEYBOARD_NAME
	default "Lily58 Left"


config ZMK_SPLIT_BLE_ROLE_CENTRAL
	default n

endif

if SHIELD_LILY58_RIGHT

config ZMK_KEYBOARD_NAME
	default "Lily58 Right"


endif

if SHIELD_LILY58_DONGLE

config ZMK_KEYBOARD_NAME
	default "Lily58 Dongle"

config ZMK_SPLIT_BLE_ROLE_CENTRAL
	default y

endif

if SHIELD_LILY58_LEFT || SHIELD_LILY58_RIGHT || SHIELD_LILY58_DONGLE || SHIELD_TIDBIT

config ZMK_SPLIT
	default y

CONFIG_ZMK_DISPLAY=y

endif 


if ZMK_DISPLAY

config I2C
    default y

config SSD1306
    default y

config SSD1306_REVERSE_MODE
        default y

endif # ZMK_DISPLAY

if LVGL

config APP_LINK_WITH_LVGL
    default y

config LVGL_USE_PERF_MONITOR
    default n

config LVGL_HOR_RES_MAX
    default 128

config LVGL_VER_RES_MAX
    default 32

config LVGL_VDB_SIZE
    default 32

config LVGL_USE_DEBUG
    default y

config LVGL_DPI
    default 148

config LVGL_BITS_PER_PIXEL
    default 1

config LVGL_FONT_MONTSERRAT_8
    default n

config LVGL_FONT_UNSCII_8
    default y

choice LVGL_COLOR_DEPTH
    default LVGL_COLOR_DEPTH_1
endchoice



endif # LVGL
```

## app/boards/shields/wiris/Kconfig.defconfig
```kconfig
if SHIELD_WIRIS_DONGLE

config ZMK_KEYBOARD_NAME
	default "Wiris"

config ZMK_SPLIT_BLE_ROLE_CENTRAL
	default y

endif

if SHIELD_WIRIS_LEFT || SHIELD_WIRIS_RIGHT || SHIELD_WIRIS_DONGLE

config ZMK_SPLIT
	default y

endif
```

## app/boards/shields/wiris/Kconfig.shield
```kconfig
# Copyright (c) 2020 The ZMK Contributors
# SPDX-License-Identifier: MIT

config SHIELD_WIRIS_LEFT
	def_bool $(shields_list_contains,wiris_left)
config SHIELD_WIRIS_RIGHT
	def_bool $(shields_list_contains,wiris_right)
config SHIELD_WIRIS_DONGLE
	def_bool $(shields_list_contains,wiris_dongle)
```
